





f_data	equ	$c2
f_size	equ	$c3
f_cmd	equ	$c4
f_error	equ	$c5
f_stat	equ	$cf



GETVER	EQU	0
GETTIME	EQU	1
SETTIME	EQU	2
OPENFILE EQU	3
READFILE EQU	4
WRITEFILE EQU	5
CLOSEFILE EQU	6

OPENDIR	EQU	8
OPENDIRLFN	EQU	8+16
READDIR	EQU	9
MOUNTDRIVE EQU	$A
DRIVEINFO EQU	$C
SECTORSTREAM EQU $F



RTCMSGSIZE	EQU	6
DRVINFOSIZE	EQU	19
DSPBUFFERLEN	EQU	81


FA_OPEN_EXISTING equ	00h
FA_READ		 equ	01h
FA_WRITE	 equ	02h
FA_CREATE_NEW	 equ	04h
FA_CREATE_ALWAYS equ	08h
FA_OPEN_ALWAYS	 equ	10h











AM_RDO	equ	$01	
AM_HID	equ	$02	
AM_SYS	equ	$04	
AM_VOL	equ	$08	
AM_LFN	equ	$0F	
AM_DIR	equ	$10	
AM_ARC	equ	$20	

